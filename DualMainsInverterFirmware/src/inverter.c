#include "inverter.h"
#include "wfg.h"
#include "dmi_adc.h"
#include "tick.h"

#define _INVERTER_BUS_VOLTAGE_FILTER_ALPHA 64 // Fixed point. Maximum 1024

// Amplitude of the baseline output. Channel A and B are referenced to this channel
#define _INVERTER_BASELINE_COEFFICIENT 169706 // amplitude millivolts

// 1000mV * (470k + 470k) / 2k = 470000 mV = full scale voltage on bus when adc reading is 2^12
#define _INVERTER_BUS_FULLSCALE_MILLIVOLTS 470000

volatile int32_t _inverter_bus_voltage_unfiltered = 0; // unfiltered bus voltage measurement from ADC

volatile int32_t _inverter_channel_a_target = 0; // amplitude (peak, not RMS) millivolts
volatile int32_t _inverter_channel_b_target = 0; // amplitude (peak, not RMS) millivolts

static uint16_t _inverter_sinelut[] = {
	0x200,0x20d,0x219,0x226,0x232,0x23f,0x24b,0x258,
	0x264,0x271,0x27d,0x289,0x295,0x2a1,0x2ad,0x2b9,
	0x2c5,0x2d0,0x2dc,0x2e7,0x2f2,0x2fd,0x308,0x313,
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	0x1a8,0x1b5,0x1c1,0x1ce,0x1da,0x1e7,0x1f3,0x200
};

void inverter_init(void) {
	wfg_init();
	dmi_adc_init();
	tick_init(_inverter_callback);
}

void inverter_housekeeping() {
	uint16_t bus_voltage_raw;
	
	dmi_adc_read_conversion(&bus_voltage_raw, ADC_POSITIVE_INPUT_PIN5);
	_inverter_bus_voltage_unfiltered = (((int32_t)bus_voltage_raw) * _INVERTER_BUS_FULLSCALE_MILLIVOLTS) >> 11;
}

void inverter_set_channels(uint32_t channel_a, uint32_t channel_b) {
	system_interrupt_enter_critical_section();
	_inverter_channel_a_target = channel_a;
	_inverter_channel_b_target = channel_b;
	system_interrupt_leave_critical_section();
}

void _inverter_callback(void) {
	static uint16_t i = 0;
	static int32_t bus_voltage = 0;
	static bool baseline_enable = false;
	
	bus_voltage = (_INVERTER_BUS_VOLTAGE_FILTER_ALPHA * _inverter_bus_voltage_unfiltered + (1024 - _INVERTER_BUS_VOLTAGE_FILTER_ALPHA) * bus_voltage) / 1024;
	
	volatile int32_t sineval_raw = (int16_t)_inverter_sinelut[i] - 512;
	volatile int32_t baseline;
	volatile int32_t chan_a, chan_b;
	
	// Hysteresis loop
	if (baseline_enable && bus_voltage - 5000 < _INVERTER_BASELINE_COEFFICIENT) {
		baseline_enable = false;
		port_pin_set_output_level(PIN_PA27, true);
	}
	else if (!baseline_enable && bus_voltage - 12000 > _INVERTER_BASELINE_COEFFICIENT) {
		baseline_enable = true;
		port_pin_set_output_level(PIN_PA27, false);
	}
	
	// Check if bus voltage is high enough to generate baseline signal
	if (baseline_enable) {
		baseline = _INVERTER_BASELINE_COEFFICIENT * sineval_raw / bus_voltage;
		// This needs to be doubled because it refers to peak-to-peak, not amplitude
		chan_a = baseline - 2 * _inverter_channel_a_target * sineval_raw / bus_voltage;
		chan_b = baseline - 2 * _inverter_channel_b_target * sineval_raw / bus_voltage;
	} else {
		// If bus voltage isn't high enough to generate baseline signal, set all outputs to zero.
		baseline = 0;
		chan_a = 0;
		chan_b = 0;
	}
	
	// Up until this point, these values could range from -512 to 512. Shift to unsigned ints
	chan_a = chan_a + 512;
	baseline = baseline + 512;
	chan_b = chan_b + 512;
	
	// Set each channel accordingly
	wfg_channel_set(WFG_CHANNEL_U, (uint16_t)chan_a);
	wfg_channel_set(WFG_CHANNEL_W, (uint16_t)chan_b);
	wfg_channel_set(WFG_CHANNEL_V, (uint16_t)baseline);
	
	// Looping index to cycle through waveform pattern
	i += 1;
	if (i >= (sizeof(_inverter_sinelut) / sizeof(uint16_t)))
		i = 0;
	
	return;
}